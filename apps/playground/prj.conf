## CMakeLists.txt
```
cmake_minimum_required(VERSION 3.20.0)
find_package(Zephyr REQUIRED HINTS $ENV{ZEPHYR_BASE})
project(openfactory_playground)
target_sources(app PRIVATE src/main.c src/monitor.c src/commands.c)
foreach(name main.c prj.conf README.txt)
  if(name STREQUAL "main.c")
    set(source ${CMAKE_CURRENT_SOURCE_DIR}/src/${name})
  else()
    set(source ${CMAKE_CURRENT_SOURCE_DIR}/${name})
  endif()
  generate_inc_file_for_target(app ${source} ${ZEPHYR_BINARY_DIR}/include/generated/${name}.inc)
endforeach()
```

## prj.conf
```kconfig
CONFIG_PRINTK=y
CONFIG_SHELL=y
CONFIG_SHELL_STACK_SIZE=8192
CONFIG_SHELL_CMD_BUFF_SIZE=256
CONFIG_KERNEL_SHELL=y
CONFIG_DEVICE_SHELL=y
CONFIG_INIT_STACKS=y
CONFIG_THREAD_STACK_INFO=y
CONFIG_THREAD_MONITOR=y
CONFIG_THREAD_NAME=y
CONFIG_THREAD_RUNTIME_STATS=y
CONFIG_THREAD_RUNTIME_STATS_USE_TIMING_FUNCTIONS=y
CONFIG_MAIN_STACK_SIZE=4096
CONFIG_FILE_SYSTEM=y
CONFIG_FILE_SYSTEM_SHELL=y
CONFIG_FILE_SYSTEM_LITTLEFS=y
CONFIG_FS_LITTLEFS_CACHE_SIZE=512
CONFIG_FS_LITTLEFS_BLK_DEV=y
CONFIG_FS_LITTLEFS_FMP_DEV=n
CONFIG_DISK_ACCESS=y
CONFIG_DISK_DRIVERS=y
CONFIG_DISK_DRIVER_RAM=y
```

## app.overlay
```dts
/ {
	playground_disk {
		compatible = "zephyr,ram-disk";
		disk-name = "PLAYGROUND";
		sector-size = <512>;
		sector-count = <128>;
	};
};
```

## src/main.c
```c
#include <errno.h>
#include <stdio.h>
#include <string.h>
#include <zephyr/fs/fs.h>
#include <zephyr/fs/littlefs.h>
#include <zephyr/kernel.h>
#include <zephyr/shell/shell.h>
#include <zephyr/sys/atomic.h>

FS_LITTLEFS_DECLARE_DEFAULT_CONFIG(playground_fs);
static struct fs_mount_t mount = {
	.type = FS_LITTLEFS,
	.fs_data = &playground_fs,
	.storage_dev = "PLAYGROUND",
	.mnt_point = "/demo",
	.flags = FS_MOUNT_FLAG_USE_DISK_ACCESS,
};

static const unsigned char readme[] = {
#include <README.txt.inc>
};
static const unsigned char source[] = {
#include <main.c.inc>
};
static const unsigned char configuration[] = {
#include <prj.conf.inc>
};
static atomic_t paused;
static atomic_t samples;
static atomic_t reset_requested;

static int write_file(const char *path, const void *data, size_t size, bool append)
{
	struct fs_file_t file;
	fs_file_t_init(&file);
	int ret = fs_open(&file, path, FS_O_CREATE | FS_O_WRITE |
			  (append ? FS_O_APPEND : FS_O_TRUNC));
	if (ret < 0) {
		return ret;
	}
	ssize_t written = fs_write(&file, data, size);
	ret = fs_close(&file);
	return written < 0 ? written : written != size ? -EIO : ret;
}

static int demo_command(const struct shell *sh, size_t argc, char **argv)
{
	if (argc == 1 || strcmp(argv[1], "status") == 0) {
		int count = atomic_get(&samples);
		shell_print(sh, "Simulated sensor: %s, samples=%d, temperature=%d.%d C",
			    atomic_get(&paused) ? "paused" : "running", count,
			    22 + (count % 20) / 10, count % 10);
		shell_print(sh, "Log: /demo/data/readings.csv; source: /demo/src/main.c");
	} else if (strcmp(argv[1], "pause") == 0) {
		atomic_set(&paused, 1);
		shell_print(sh, "Demo paused");
	} else if (strcmp(argv[1], "resume") == 0) {
		atomic_clear(&paused);
		shell_print(sh, "Demo running");
	} else if (strcmp(argv[1], "reset") == 0) {
		atomic_set(&reset_requested, 1);
		shell_print(sh, "Demo reset requested");
	} else {
		shell_error(sh, "Use demo [status|pause|resume|reset]");
		return -EINVAL;
	}
	return 0;
}
SHELL_CMD_ARG_REGISTER(demo, NULL, "Simulated sensor: status, pause, resume, reset.",
		       demo_command, 1, 1);

int main(void)
{
	k_thread_name_set(k_current_get(), "sample_sensor");
	int ret = fs_mount(&mount);
	if (ret < 0) {
		printk("Playground filesystem failed: %d\n", ret);
		return ret;
	}
	ret = fs_mkdir("/demo/src");
	if (ret == 0) {
		ret = fs_mkdir("/demo/data");
	}
	if (ret == 0) {
		ret = write_file("/demo/README.txt", readme, sizeof(readme), false);
	}
	if (ret == 0) {
		ret = write_file("/demo/src/main.c", source, sizeof(source), false);
	}
	if (ret == 0) {
		ret = write_file("/demo/prj.conf", configuration, sizeof(configuration), false);
	}
	if (ret < 0) {
		printk("Playground files failed: %d\n", ret);
		return ret;
	}
	printk("\nOpenFactory Zephyr playground\n"
	       "Try: ls, cd /demo, cat README.txt, demo status, top, htop\n"
	       "The /demo RAM disk resets when the machine restarts.\n\n");
	for (;;) {
		if (atomic_cas(&reset_requested, 1, 0)) {
			atomic_clear(&samples);
		}
		int count = atomic_get(&samples);
		if (count == 0 || (!atomic_get(&paused) && count % 60 == 0)) {
			static const char header[] = "sample,uptime_ms,simulated_temperature_c\n";
			ret = write_file("/demo/data/readings.csv", header, sizeof(header) - 1, false);
		}
		if (ret == 0 && !atomic_get(&paused)) {
			char row[64];
			count = atomic_inc(&samples) + 1;
			int size = snprintf(row, sizeof(row), "%d,%lld,%d.%d\n", count,
					    (long long)k_uptime_get(), 22 + (count % 20) / 10,
					    count % 10);
			ret = write_file("/demo/data/readings.csv", row, size, true);
		}
		if (ret < 0) {
			printk("Demo log write failed: %d\n", ret);
			return ret;
		}
		k_sleep(K_SECONDS(1));
	}
}
```

## src/commands.c
```c
/* Familiar names for Zephyr's existing filesystem and kernel commands. */
#include <errno.h>
#include <string.h>
#include <zephyr/shell/shell.h>
#include <zephyr/sys/iterable_sections.h>

/* Call the registered static handler directly: shell_execute_cmd() must
 * never be called recursively from inside a shell command handler.
 */
static int native_command(const struct shell *sh, size_t argc, char **argv,
			  const char *root, const char *group, const char *name)
{
	TYPE_SECTION_FOREACH(union shell_cmd_entry, shell_root_cmds, cmd) {
		if (strcmp(cmd->entry->syntax, root) != 0) {
			continue;
		}
		const struct shell_static_entry *entry = cmd->entry;
		const char *path[] = {group, name};
		for (size_t i = 0; i < ARRAY_SIZE(path); i++) {
			if (path[i] == NULL) {
				continue;
			}
			if (entry->subcmd == NULL) {
				return -ENOENT;
			}
			/* Section command sets start with an empty descriptor. */
			entry = entry->subcmd->entry ? entry->subcmd->entry :
				(const struct shell_static_entry *)entry->subcmd + 1;
			while (entry->syntax && strcmp(entry->syntax, path[i]) != 0) {
				entry++;
			}
			if (entry->syntax == NULL) {
				return -ENOENT;
			}
		}
		return entry->handler ? entry->handler(sh, argc, argv) : -ENOENT;
	}
	return -ENOENT;
}

static int filesystem_command(const struct shell *sh, size_t argc, char **argv)
{
	return native_command(sh, argc, argv, "fs", NULL, argv[0]);
}

static int ps_command(const struct shell *sh, size_t argc, char **argv)
{
	return native_command(sh, argc, argv, "kernel", "thread", "list");
}

static int uptime_command(const struct shell *sh, size_t argc, char **argv)
{
	return native_command(sh, argc, argv, "kernel", NULL, "uptime");
}

static int version_command(const struct shell *sh, size_t argc, char **argv)
{
	return native_command(sh, argc, argv, "kernel", NULL, "version");
}

SHELL_CMD_ARG_REGISTER(ls, NULL, "List files [path].", filesystem_command, 1, 1);
SHELL_CMD_ARG_REGISTER(cd, NULL, "Change directory [path].", filesystem_command, 1, 1);
SHELL_CMD_ARG_REGISTER(pwd, NULL, "Print working directory.", filesystem_command, 1, 0);
SHELL_CMD_ARG_REGISTER(cat, NULL, "Read text files <path> [...].", filesystem_command, 2, 8);
SHELL_CMD_ARG_REGISTER(mkdir, NULL, "Create directory <path>.", filesystem_command, 2, 0);
SHELL_CMD_ARG_REGISTER(cp, NULL, "Copy file <source> <dest>.", filesystem_command, 3, 0);
SHELL_CMD_ARG_REGISTER(mv, NULL, "Move file <source> <dest>.", filesystem_command, 3, 0);
SHELL_CMD_ARG_REGISTER(rm, NULL, "Remove file or directory <path>.", filesystem_command, 2, 0);
SHELL_CMD_ARG_REGISTER(ps, NULL, "List Zephyr threads and runtime statistics.", ps_command, 1, 0);
SHELL_CMD_ARG_REGISTER(uptime, NULL, "Show time since boot.", uptime_command, 1, 0);
SHELL_CMD_ARG_REGISTER(version, NULL, "Show Zephyr version.", version_command, 1, 0);
```

## src/monitor.c
```c
/* Native Zephyr thread monitors; both commands share one renderer. */
#include <errno.h>
#include <string.h>
#include <zephyr/kernel.h>
#include <zephyr/shell/shell.h>

struct thread_sample {
	const struct k_thread *thread;
	uint64_t cycles;
};

struct monitor {
	struct thread_sample previous[32];
	uint64_t total;
	uint64_t elapsed;
	const struct shell *shell;
	bool render;
	bool color;
	bool truncated;
};

static void sample_thread(const struct k_thread *thread, void *data)
{
	struct monitor *monitor = data;
	k_thread_runtime_stats_t stats;
	if (k_thread_runtime_stats_get((k_tid_t)thread, &stats) < 0) {
		return;
	}
	size_t index;
	for (index = 0; index < ARRAY_SIZE(monitor->previous); index++) {
		if (monitor->previous[index].thread == thread ||
		    monitor->previous[index].thread == NULL) {
			break;
		}
	}
	if (index == ARRAY_SIZE(monitor->previous)) {
		monitor->truncated = true;
		return;
	}
	uint64_t delta = stats.execution_cycles - monitor->previous[index].cycles;
	monitor->previous[index] = (struct thread_sample){thread, stats.execution_cycles};
	if (!monitor->render) {
		return;
	}
	unsigned int percent = monitor->elapsed ? MIN(100ULL, delta * 100 / monitor->elapsed) : 0;
	size_t unused;
	char stack[32] = "unavailable";
	char state[32];
	const char *name = k_thread_name_get((k_tid_t)thread);
	if (k_thread_stack_space_get(thread, &unused) == 0) {
		snprintk(stack, sizeof(stack), "%zu/%zu", thread->stack_info.size - unused,
			 thread->stack_info.size);
	}
	shell_print(monitor->shell, "%s%-18.18s %5u%% %6d %-16s %s%s",
		    monitor->color && percent > 0 ? "\033[32m" : "", name ? name : "unnamed",
		    percent, k_thread_priority_get((k_tid_t)thread), stack,
		    k_thread_state_str((k_tid_t)thread, state, sizeof(state)),
		    monitor->color ? "\033[0m" : "");
}

static int monitor_command(const struct shell *sh, size_t argc, char **argv)
{
	bool once = argc == 2 && strcmp(argv[1], "--once") == 0;
	if (argc == 2 && !once) {
		shell_error(sh, "Use %s [--once]", argv[0]);
		return -EINVAL;
	}
	struct monitor monitor = {.shell = sh, .color = strcmp(argv[0], "htop") == 0};
	k_thread_runtime_stats_t stats;
	if (k_thread_runtime_stats_all_get(&stats) < 0) {
		return -ENOTSUP;
	}
	monitor.total = stats.execution_cycles;
	k_thread_foreach_unlocked(sample_thread, &monitor);
	if (!once) {
		shell_print(sh, "\033[?25l");
	}
	int ret = 0;
	for (;;) {
		/* Let sleeping threads accumulate real runtime between samples. */
		k_sleep(K_SECONDS(1));
		if (k_thread_runtime_stats_all_get(&stats) < 0) {
			ret = -EIO;
			break;
		}
		monitor.elapsed = stats.execution_cycles - monitor.total;
		monitor.total = stats.execution_cycles;
		monitor.render = true;
		if (!once) {
			shell_fprintf(sh, SHELL_NORMAL, "\033[H\033[2J");
		}
		shell_print(sh, "%sZephyr %s | uptime %lld ms | q + Enter or Ctrl+C to quit%s",
			    monitor.color ? "\033[1;36m" : "", argv[0], (long long)k_uptime_get(),
			    monitor.color ? "\033[0m" : "");
		shell_print(sh, "THREAD              CPU%%    PRI STACK used/total STATE");
		k_thread_foreach_unlocked(sample_thread, &monitor);
		if (monitor.truncated) {
			shell_print(sh, "Showing first %zu threads", ARRAY_SIZE(monitor.previous));
		}
		if (once) {
			break;
		}
		uint8_t input[16];
		int count = shell_readline(sh, input, sizeof(input), K_SECONDS(1));
		if (count == -ECANCELED || (count > 0 && input[0] == 'q')) {
			break;
		}
		if (count < 0 && count != -ETIMEDOUT && count != -ENOBUFS) {
			ret = count;
			break;
		}
	}
	if (!once) {
		shell_print(sh, "\033[0m\033[?25hMonitor stopped");
	}
	return ret;
}

SHELL_CMD_ARG_REGISTER(top, NULL, "Live Zephyr thread monitor [--once]. Quit: q + Enter or Ctrl+C.",
		       monitor_command, 1, 1);
SHELL_CMD_ARG_REGISTER(htop, NULL, "Colored Zephyr thread monitor [--once]. Quit: q + Enter or Ctrl+C.",
		       monitor_command, 1, 1);
```
