## west.yml
```yaml
manifest:
  remotes:
    - name: zephyrproject
      url-base: https://github.com/zephyrproject-rtos
  projects:
    - name: zephyr
      remote: zephyrproject
      revision: dccb09599635bdff17633fa7e9dab014b91dce90
      import: true
  self:
    path: manifest
```
